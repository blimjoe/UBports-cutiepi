/dts-v1/;
/plugin/;

/ {
    compatible = "brcm,bcm2711";

    fragment@0 {
        target = <&i2c5>;
        __overlay__ {
            #address-cells = <1>;
            #size-cells = <0>;
            clock-frequency = <400000>;

            mpu6050@68 {
                compatible = "invensense,mpu6050";
                reg = <0x68>;
                interrupt-parent = <&gpio>;
                interrupts = <27 1>;
                mount-matrix = "1", "0", "0",
                               "0", "-1", "0",
                               "0", "0", "1";
            };
        };
    };
};
