/dts-v1/;
/plugin/;

/ {
    compatible = "brcm,bcm2711";
    fragment@0 {
        target-path = "/";
        __overlay__ {
            model = "CutiePi";
            chassis-type = "tablet";
        };
    };
};
